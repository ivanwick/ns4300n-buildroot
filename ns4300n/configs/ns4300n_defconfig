## ns4300n/configs/ns4300n_defconfig
```kconfig
BR2_powerpc=y
BR2_powerpc_e300c3=y
BR2_GLOBAL_PATCH_DIR="$(BR2_EXTERNAL_NS4300N_PATH)/patches/"
BR2_KERNEL_HEADERS_4_15=y
BR2_ROOTFS_OVERLAY="$(BR2_EXTERNAL_NS4300N_PATH)/rootfs_overlay"
BR2_LINUX_KERNEL=y
BR2_LINUX_KERNEL_LATEST_CIP_VERSION=y
BR2_LINUX_KERNEL_USE_CUSTOM_CONFIG=y
BR2_LINUX_KERNEL_CUSTOM_CONFIG_FILE="$(BR2_EXTERNAL_NS4300N_PATH)/kernel.config"
BR2_LINUX_KERNEL_CUIMAGE=y
BR2_LINUX_KERNEL_INTREE_DTS_NAME="mpc834x_mds"
BR2_PACKAGE_DROPBEAR=y
BR2_PACKAGE_ETHTOOL=y
BR2_TARGET_ROOTFS_CPIO=y
BR2_TARGET_ROOTFS_CPIO_GZIP=y
BR2_TARGET_ROOTFS_CPIO_UIMAGE=y
# BR2_TARGET_ROOTFS_TAR is not set
```
